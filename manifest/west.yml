## manifest/west.yml
```yaml
manifest:
  self:
    path: .
  remotes:
    - name: zephyrproject-rtos
      url-base: https://github.com/zephyrproject-rtos
    - name: eclipse-zenoh
      url-base: https://github.com/eclipse-zenoh
  projects:
    - name: zephyr
      remote: zephyrproject-rtos
      revision: main
      path: modules/lib/zephyr
      import: true
    - name: zenoh-pico
      remote: eclipse-zenoh
      revision: main
      path: modules/lib/zenoh-pico
```
